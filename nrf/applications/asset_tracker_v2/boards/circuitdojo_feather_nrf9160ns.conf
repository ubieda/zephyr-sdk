## nrf/applications/asset_tracker_v2/boards/circuitdojo_feather_nrf9160ns.conf
```kconfig
CONFIG_NRF9160_GPS_ANTENNA_EXTERNAL=y
CONFIG_NRF9160_GPS_SET_COEX0=y
CONFIG_NRF9160_GPS_COEX0_STRING="AT\%XCOEX0=1,1,1565,1586"
```
